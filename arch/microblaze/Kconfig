## arch/microblaze/Kconfig
```kconfig
menu "MicroBlaze architecture"
	depends on MICROBLAZE

config SYS_ARCH
	default "microblaze"

config STATIC_RELA
	def_bool y

choice
	prompt "Target select"
	optional

config TARGET_MICROBLAZE_GENERIC
	bool "Support microblaze-generic"
	select BOARD_LATE_INIT
	select DM
	select DM_SERIAL
	select OF_CONTROL
	select SUPPORT_SPL
	select SPL_LIBCOMMON_SUPPORT if SPL
	select SPL_LIBGENERIC_SUPPORT if SPL
	select SYSRESET
	select DM_SPI
	select DM_SPI_FLASH
	select MTD
	select SPI
	imply CMD_DM

config TARGET_MICROBLAZE_THUNDERHILL
	bool "Support microblaze-thunderhill"
	select DM
	select MMC
	select CLK
	select TIMER
	select DM_SERIAL
	select OF_CONTROL
	select SUPPORT_SPL
	select SPL_LIBCOMMON_SUPPORT if SPL
	select SPL_LIBGENERIC_SUPPORT if SPL
	select SPL_MMC
	select SPL_DM
	select SPL_SERIAL
	select SPL_CLK
	select SPL_TIMER

endchoice

source "board/xilinx/Kconfig"
source "board/xilinx/microblaze-generic/Kconfig"
source "board/xilinx/microblaze-thunderhill/Kconfig"

endmenu
```

## board/ventana/vt1/Kconfig
```kconfig
if TARGET_VENTANA_VT1

config SYS_BOARD
	default "vt1"

config SYS_VENDOR
	default "ventana"

config SYS_CPU
	default "generic"

config SYS_CONFIG_NAME
	default "ventana-vt1"

config SYS_DRAM_BASE
	hex "DRAM base address"
	default 0x80000000
	help
	  Set DRAM base address.

config TEXT_BASE
	hex "Text base address"
	default 0x80200000
	help
	  Set text base address.

config SPL_TEXT_BASE
	hex "SPL text base address"
	default 0x84000000
	help
	  Set SPL text base address.

config SPL_OPENSBI_LOAD_ADDR
	hex "OpenSBI load address"
	default 0x87000000
	help
	  Set OpenSBI load address

config ENV_KERNEL_ADDR_R
	hex "Default value of kernel_addr_r"
	default 0x90000000
	help
	  Set default value of kernel_addr_r environment variable

config ENV_FDT_ADDR_R
	hex "Default value of fdt_addr_r"
	default 0x94000000
	help
	  Set default value of fdt_addr_r environment variable

config ENV_SCRIPTADDR
	hex "Default value of scriptaddr"
	default 0x94100000
	help
	  Set default value of scriptaddr environment variable

config ENV_PXEFILE_ADDR_R
	hex "Default value of pxefile_addr_r"
	default 0x94200000
	help
	  Set default value of pxefile_addr_r environment variable

config ENV_RAMDISK_ADDR_R
	hex "Default value of ramdisk_addr_r"
	default 0x95000000
	help
	  Set default value of ramdisk_addr_r environment variable

config BOARD_SPECIFIC_OPTIONS # dummy
	def_bool y
	select GENERIC_RISCV
	select SUPPORT_SPL
	imply AHCI
	imply SMP
	imply BOARD_LATE_INIT
	imply PCI_INIT_R
	imply SPL_RAM_SUPPORT
	imply SPL_RAM_DEVICE
	imply CMD_PCI
	imply CMD_POWEROFF
	imply CMD_SCSI
	imply CMD_PING
	imply CMD_EXT2
	imply CMD_EXT4
	imply CMD_FAT
	imply CMD_FS_GENERIC
	imply DOS_PARTITION
	imply ISO_PARTITION
	imply EFI_PARTITION
	imply SCSI_AHCI
	imply AHCI_PCI
	imply E1000
	imply NVME
	imply NVME_PCI
	imply PCI
	imply PCIE_ECAM_GENERIC
	imply SCSI
	imply DM_SCSI
	imply SYS_NS16550
	imply HTIF_CONSOLE if 64BIT
	imply SYSRESET
	imply SYSRESET_CMD_POWEROFF
	imply VIRTIO_MMIO
	imply VIRTIO_PCI
	imply VIRTIO_NET
	imply VIRTIO_BLK
	imply MTD_NOR_FLASH
	imply CFI_FLASH

endif
```

## configs/microblaze-thunderhill-v1_defconfig
```kconfig
CONFIG_MICROBLAZE=y
CONFIG_SYS_CONFIG_NAME="microblaze-thunderhill"
CONFIG_TEXT_BASE=0x29000000
CONFIG_SYS_MALLOC_LEN=0xc0000
CONFIG_SYS_MALLOC_F_LEN=0x10000
CONFIG_NR_DRAM_BANKS=1
CONFIG_ENV_SIZE=0x20000
CONFIG_DEFAULT_DEVICE_TREE="microblaze-thunderhill"
CONFIG_SPL_STACK=0x40000
CONFIG_SPL=y
CONFIG_DEBUG_UART_BASE=0x40600000
CONFIG_DEBUG_UART_CLOCK=30000000
CONFIG_IDENT_STRING="microblaze-thunderhill"
CONFIG_ZYNQ_SDHCI_MAX_FREQ=100000000
CONFIG_SYS_LOAD_ADDR=0x0
CONFIG_TARGET_MICROBLAZE_THUNDERHILL=y
CONFIG_TARGET_THUNDERHILL_V1=y
CONFIG_DEBUG_UART=y
CONFIG_SYS_LITTLE_ENDIAN=y
CONFIG_REMAKE_ELF=y
# CONFIG_BOOTSTD is not set
# CONFIG_LEGACY_IMAGE_FORMAT is not set
CONFIG_SYS_CBSIZE=512
CONFIG_SYS_PBSIZE=544
CONFIG_SYS_CONSOLE_IS_IN_ENV=y
CONFIG_DISPLAY_BOARDINFO=y
CONFIG_DISPLAY_BOARDINFO_LATE=y
CONFIG_SPL_FOOTPRINT_LIMIT=y
CONFIG_SPL_MAX_FOOTPRINT=0xffb00
CONFIG_SPL_BOARD_INIT=y
# CONFIG_SPL_RAW_IMAGE_SUPPORT is not set
# CONFIG_SPL_LEGACY_IMAGE_FORMAT is not set
# CONFIG_SPL_SHARES_INIT_SP_ADDR is not set
# CONFIG_SYS_MMCSD_FS_BOOT is not set
# CONFIG_SPL_RAM_SUPPORT is not set
# CONFIG_CMDLINE is not set
CONFIG_SPL_OF_CONTROL=y
CONFIG_OF_EMBED=y
CONFIG_OF_SPL_REMOVE_PROPS=""
# CONFIG_NET is not set
CONFIG_SPL_CLK_CCF=y
CONFIG_SPL_CLK_COMPOSITE_CCF=y
CONFIG_CLK_CCF=y
CONFIG_CLK_COMPOSITE_CCF=y
CONFIG_CLK_XLNX_CLKWZRD=y
# CONFIG_GPIO is not set
# CONFIG_I2C is not set
# CONFIG_INPUT is not set
CONFIG_SPL_MMC_HS400_ES_SUPPORT=y
CONFIG_SPL_MMC_HS400_SUPPORT=y
CONFIG_MMC_SDHCI=y
CONFIG_MMC_SDHCI_ZYNQ=y
# CONFIG_POWER is not set
CONFIG_BAUDRATE=9600
CONFIG_SERIAL_RX_BUFFER=y
CONFIG_SERIAL_SEARCH_ALL=y
CONFIG_SERIAL_PROBE_ALL=y
CONFIG_XILINX_UARTLITE=y
CONFIG_WDT=y
CONFIG_XILINX_TB_WATCHDOG=y
# CONFIG_SPL_USE_TINY_PRINTF is not set
# CONFIG_GZIP is not set
# CONFIG_LMB is not set
# CONFIG_LMB_USE_MAX_REGIONS is not set
```

## configs/ventana-vt1-jtag_defconfig
```kconfig
CONFIG_RISCV=y
CONFIG_SYS_MALLOC_LEN=0x100000
CONFIG_SYS_MALLOC_F_LEN=0x2000
CONFIG_NR_DRAM_BANKS=1
CONFIG_HAS_CUSTOM_SYS_INIT_SP_ADDR=y
CONFIG_CUSTOM_SYS_INIT_SP_ADDR=0x80200000
CONFIG_ENV_SIZE=0x20000
CONFIG_DEFAULT_DEVICE_TREE="ventana-vt1"
CONFIG_SYS_LOAD_ADDR=0x80200000
CONFIG_TARGET_VENTANA_VT1=y
CONFIG_ARCH_RV64I=y
CONFIG_RISCV_SMODE=y
CONFIG_FIT=y
CONFIG_SYS_BOOTM_LEN=0x4000000
CONFIG_DISTRO_DEFAULTS=y
CONFIG_BOOTCOMMAND="booti 0x80200000 - ${fdtcontroladdr}"
CONFIG_SYS_CBSIZE=256
CONFIG_SYS_PBSIZE=276
CONFIG_DISPLAY_CPUINFO=y
CONFIG_DISPLAY_BOARDINFO=y
CONFIG_CMD_SBI=y
CONFIG_CMD_CLK=y
CONFIG_CMD_MMC=y
CONFIG_STACK_SIZE=0x4000
# CONFIG_CMD_MII is not set
CONFIG_OF_LIVE=y
CONFIG_OF_BOARD=y
CONFIG_SYS_RELOC_GD_ENV_ADDR=y
# CONFIG_OFNODE_MULTI_TREE is not set
CONFIG_CLK_CCF=y
CONFIG_MMC=y
CONFIG_DM_MTD=y
# CONFIG_SERIAL_PUTS is not set
CONFIG_SERIAL_PROBE_ALL=y
CONFIG_SEMIHOSTING_SERIAL=y
CONFIG_SPI=y
CONFIG_SEMIHOSTING=y
# CONFIG_EFI_LOADER is not set
```

## configs/ventana-vt1_defconfig
```kconfig
CONFIG_RISCV=y
CONFIG_SYS_MALLOC_LEN=0x1000000
CONFIG_SYS_MALLOC_F_LEN=0x2000
CONFIG_NR_DRAM_BANKS=1
CONFIG_HAS_CUSTOM_SYS_INIT_SP_ADDR=y
CONFIG_CUSTOM_SYS_INIT_SP_ADDR=0x80200000
CONFIG_ENV_SIZE=0x20000
CONFIG_DEFAULT_DEVICE_TREE="ventana-vt1"
CONFIG_SPL=y
CONFIG_SPL_FS_LOADER=y
CONFIG_SPL_FS_FAT=y
CONFIG_SYS_LOAD_ADDR=0x80200000
CONFIG_TARGET_VENTANA_VT1=y
CONFIG_ARCH_RV64I=y
CONFIG_RISCV_SMODE=y
# CONFIG_SPL_SMP is not set
CONFIG_FIT=y
CONFIG_SPL_LOAD_FIT_ADDRESS=0x88000000
CONFIG_SYS_BOOTM_LEN=0x4000000
CONFIG_DISTRO_DEFAULTS=y
CONFIG_BOOTCOMMAND="booti 0x89000000 - ${fdtcontroladdr}"
CONFIG_SYS_CBSIZE=256
CONFIG_SYS_PBSIZE=276
CONFIG_DISPLAY_CPUINFO=y
CONFIG_DISPLAY_BOARDINFO=y
CONFIG_SPL_MAX_SIZE=0x100000
CONFIG_SPL_BSS_START_ADDR=0x84F00000
CONFIG_SPL_SYS_MALLOC=y
CONFIG_SPL_SYS_MALLOC_SIZE=0x1000000
CONFIG_SPL_FS_EXT4=y
CONFIG_CMD_SBI=y
CONFIG_CMD_NVEDIT_EFI=y
CONFIG_CMD_MMC=y
# CONFIG_CMD_MII is not set
CONFIG_CMD_EFIDEBUG=y
CONFIG_OF_LIVE=y
CONFIG_OF_BOARD=y
CONFIG_SYS_RELOC_GD_ENV_ADDR=y
# CONFIG_OFNODE_MULTI_TREE is not set
CONFIG_MMC=y
CONFIG_DM_MTD=y
# CONFIG_SERIAL_PUTS is not set
CONFIG_SERIAL_PROBE_ALL=y
CONFIG_SEMIHOSTING_SERIAL=y
# CONFIG_BINMAN_FDT is not set
CONFIG_SEMIHOSTING=y
# CONFIG_SMBIOS is not set
CONFIG_CMD_VMSTRACE=y
```

## configs/ventana-vtx-fpga-jtag_defconfig
```kconfig
CONFIG_RISCV=y
CONFIG_TEXT_BASE=0x400200000
CONFIG_SYS_MALLOC_LEN=0x100000
CONFIG_SYS_MALLOC_F_LEN=0x2000
CONFIG_NR_DRAM_BANKS=2
CONFIG_ENV_SIZE=0x20000
CONFIG_DEFAULT_DEVICE_TREE="ventana-vt1"
CONFIG_SYS_LOAD_ADDR=0x400200000
CONFIG_TARGET_VENTANA_VT1=y
CONFIG_SYS_DRAM_BASE=0x400000000
CONFIG_ARCH_RV64I=y
CONFIG_RISCV_SMODE=y
CONFIG_DISTRO_DEFAULTS=y
CONFIG_HAS_CUSTOM_SYS_INIT_SP_ADDR=y
CONFIG_CUSTOM_SYS_INIT_SP_ADDR=0x400200000
CONFIG_FIT=y
CONFIG_BOOTCOMMAND="booti 0x400200000 - ${fdtcontroladdr}"
CONFIG_DISPLAY_CPUINFO=y
CONFIG_DISPLAY_BOARDINFO=y
CONFIG_SYS_CBSIZE=256
CONFIG_SYS_PBSIZE=276
CONFIG_CMD_SBI=y
CONFIG_SYS_BOOTM_LEN=0x4000000
# CONFIG_CMD_MII is not set
CONFIG_OF_LIVE=y
CONFIG_OF_BOARD=y
CONFIG_SYS_RELOC_GD_ENV_ADDR=y
# CONFIG_OFNODE_MULTI_TREE is not set
CONFIG_DM_MTD=y
# CONFIG_SERIAL_PUTS is not set
CONFIG_SERIAL_PROBE_ALL=y
CONFIG_SEMIHOSTING_SERIAL=y
# CONFIG_BINMAN_FDT is not set
CONFIG_SEMIHOSTING=y
# CONFIG_EFI_LOADER is not set
CONFIG_XILINX_AXIEMAC=y
CONFIG_XILINX_EMACLITE=y
CONFIG_MMC=y
CONFIG_MMC_SDHCI=y
CONFIG_MMC_SDHCI_ZYNQ=y
CONFIG_ZYNQ_SDHCI_MAX_FREQ=200000000
CONFIG_PCI_XILINX=y
CONFIG_CMD_MMC=y
CONFIG_MMC_HS400_ES_SUPPORT=y
CONFIG_MMC_HS400_SUPPORT=y
CONFIG_MMC_HS200_SUPPORT=y
CONFIG_MMC_SDHCI=y
CONFIG_DM_MMC=y
CONFIG_RISCV_ISA_ZICBOM=y
```

## configs/ventana-vtx-synth_defconfig
```kconfig
CONFIG_RISCV=y
CONFIG_SYS_MALLOC_LEN=0x1000000
CONFIG_SYS_MALLOC_F_LEN=0x2000
CONFIG_NR_DRAM_BANKS=1
CONFIG_ENV_SIZE=0x20000
CONFIG_DEFAULT_DEVICE_TREE="ventana-vt1"
CONFIG_SPL=y
CONFIG_SPL_FIT_SIGNATURE=y
CONFIG_SPL_SHA384=y
CONFIG_SPL_FS_LOADER=y
CONFIG_SPL_FS_FAT=y
CONFIG_SYS_LOAD_ADDR=0x80200000
CONFIG_TARGET_VENTANA_VT1=y
CONFIG_ARCH_RV64I=y
CONFIG_RISCV_SMODE=y
# CONFIG_SPL_SMP is not set
CONFIG_DISTRO_DEFAULTS=y
CONFIG_HAS_CUSTOM_SYS_INIT_SP_ADDR=y
CONFIG_CUSTOM_SYS_INIT_SP_ADDR=0x80200000
CONFIG_FIT=y
CONFIG_FIT_SIGNATURE=y
CONFIG_SHA384=y
CONFIG_SPL_LOAD_FIT_ADDRESS=0x88000000
CONFIG_DISPLAY_CPUINFO=y
CONFIG_DISPLAY_BOARDINFO=y
CONFIG_SPL_MAX_SIZE=0x100000
CONFIG_SPL_BSS_START_ADDR=0x84F00000
CONFIG_SPL_SYS_MALLOC=y
CONFIG_SPL_SYS_MALLOC_SIZE=0x1000000
CONFIG_SPL_FS_EXT4=y
CONFIG_SYS_CBSIZE=256
CONFIG_SYS_PBSIZE=276
CONFIG_CMD_SBI=y
CONFIG_SYS_BOOTM_LEN=0x4000000
# CONFIG_CMD_MII is not set
CONFIG_CMD_NVEDIT_EFI=y
CONFIG_CMD_EFIDEBUG=y
CONFIG_CMD_EFICONFIG=y
CONFIG_OF_LIVE=y
CONFIG_OF_BOARD=y
CONFIG_SYS_RELOC_GD_ENV_ADDR=y
# CONFIG_OFNODE_MULTI_TREE is not set
CONFIG_DM_MTD=y
# CONFIG_SERIAL_PUTS is not set
CONFIG_SERIAL_PROBE_ALL=y
CONFIG_SEMIHOSTING_SERIAL=y
# CONFIG_BINMAN_FDT is not set
CONFIG_SEMIHOSTING=y
CONFIG_MMC=y
CONFIG_MMC_SDHCI=y
CONFIG_MMC_SDHCI_ZYNQ=y
CONFIG_ZYNQ_SDHCI_MAX_FREQ=200000000
CONFIG_SPL_NVME=y
CONFIG_SPL_PCI=y
CONFIG_SPL_PCI_PNP=y
CONFIG_SPL_NVME_PCI=y
CONFIG_SPL_ESP_BOOT=y
CONFIG_SPL_FS_LOAD_PAYLOAD_NAME="FIRMWARE/ventana/synth-vx/fw.itb"
CONFIG_CMD_MMC=y
CONFIG_SPL_MMC=y
CONFIG_MMC_HS400_ES_SUPPORT=y
CONFIG_SPL_MMC_HS400_ES_SUPPORT=y
CONFIG_MMC_HS400_SUPPORT=y
CONFIG_SPL_MMC_HS400_SUPPORT=y
CONFIG_MMC_HS200_SUPPORT=y
CONFIG_SPL_MMC_HS200_SUPPORT=y
CONFIG_MMC_SDHCI=y
CONFIG_DM_MMC=y
CONFIG_SPL_DM_MMC=y
CONFIG_SPL_CLK=y
# CONFIG_SMBIOS is not set
# CONFIG_GENERATE_SMBIOS_TABLE is not set
CONFIG_RISCV_ISA_ZICBOM=y
CONFIG_IOMMU=y
CONFIG_RISCV_IOMMU=y
CONFIG_SPL_IOMMU=y
CONFIG_SPL_RISCV_IOMMU=y
CONFIG_SPL_DM_DEVICE_REMOVE=y
```
